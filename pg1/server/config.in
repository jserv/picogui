## pgserver/config.in
```kconfig
mainmenu_name "PicoGUI Configuration"

mainmenu_option next_comment
comment 'Target System'

choice 'Platform' \
	"Linux-generic                  CONFIG_LINUX_GENERIC \
	 uClinux-m68k 	        	UCLINUX \
	 Linux-mips                     CONFIG_LINUX_MIPS \
	 
	 Windows			WINDOWS" Linux-generic
if [ "$UCLINUX" = "y" ]; then
    choice 'Platform running uClinux' \
        "Generic                CONFIG_UCLINUX_GENERIC \
	 Real_ChipSlice         CONFIG_CHIPSLICE \
         Soft_ChipSlice         CONFIG_SOFT_CHIPSLICE \
         Xcopilot               CONFIG_XCOPILOT" Generic
    bool 'm68k asm optimization (not implemented)' ASM_68000
fi
if [ "$CONFIG_LINUX_GENERIC" = "y" ]; then
    bool 'x86 asm optimization'             ASM_INTEL
fi

bool 'Use UNIX sockets instead of TCP/IP'   CONFIG_UNIX_SOCKET
bool 'Optimize for size'    CONFIG_OPTIMIZE_SIZE
bool 'Optimize for speed'   CONFIG_OPTIMIZE_SPEED
bool 'Maximum speed optimization (Breaks on some architectures!)'   CONFIG_MAX_OPTIMIZE
bool 'Statically link'      CONFIG_LINK_STATIC
endmenu

mainmenu_option next_comment
comment 'Debugging'
bool 'Enable text messages'             CONFIG_TEXT
if [ "$UCLINUX" != "y" ]; then
    bool 'Debugging symbols in binary'      CONFIG_NOSTRIP
fi
bool 'Debugging keys'                   DEBUG_KEYS
bool 'Video test mode'                  CONFIG_VIDEOTEST
bool 'Electric Fence malloc debugging'  CONFIG_EFENCE
bool 'gcov coverage analysis'           CONFIG_GCOV
bool 'gprof profiling'                  CONFIG_GPROF
bool 'Terminal prints unknown escapes'  BOTHERSOME_TERMINAL
bool 'Widget debugging'                 DEBUG_WIDGET
bool 'Event debugging'                  DEBUG_EVENT
bool 'Video debugging'                  DEBUG_VIDEO
bool 'Theme debugging'                  DEBUG_THEME
bool 'Client/server debugging'          DEBUG_NET
bool 'Initialization debugging'         DEBUG_INIT
bool 'Memory debugging'                 DEBUG_MEMORY
bool 'Mirror guru() output on stderr'   CONFIG_STDERR_GURU
bool 'HTML parser debugging'            DEBUG_HTML
bool 'Disable pixel/getpixel in x11'    CONFIG_X11_NOPIXEL
bool 'Update the entire surface in sdlfb' CONFIG_SDL_FULLUPDATE
bool 'PicoGUI error tracing'            CONFIG_ERROR_TRACE
bool 'Virtual terminal debugging'       DEBUG_VT
bool 'Video driver debugging'           DEBUG_VIDEODRIVER
bool 'Dont catch fatal signals'         DEBUG_FATALSIGNALS
bool 'Trace location of fatal signals'  DEBUG_SIGTRACE
endmenu

mainmenu_option next_comment
comment 'Fonts'
bool 'Helvetica 10 (default font)'         FONT_HELVETICA10
bool 'Clean 12 (default fixed-width font)' FONT_CLEAN12
bool 'Lucida 10'                           FONT_LUCIDA10
bool 'Clean 6'                             FONT_CLEAN6
bool 'Console 8'                           FONT_CONSOLE8
bool 'Courier 12, 12b'                     FONT_COURIER12
bool 'Helvetica 8'                         FONT_HELVETICA8
bool 'Helvetica 12, 12b'                   FONT_HELVETICA12
bool 'Helvetica 14, 14b'                   FONT_HELVETICA14
bool 'Helvetica 18, 18b'                   FONT_HELVETICA18
bool 'Helvetica 24, 24b'                   FONT_HELVETICA24
bool 'Times 10, 10b'                       FONT_TIMES10
bool 'Utopia 25'                           FONT_UTOPIA25
bool 'Fixed 13 ja (Japanese Unicode)'      FONT_FIXED13JA
endmenu

mainmenu_option next_comment
comment 'Video Drivers'
bool 'Linux framebuffer device'            DRIVER_FBDEV
if [ "$DRIVER_FBDEV" = "y" ]; then
   bool '  VR3 framebuffer palette fix'    CONFIG_FIX_VR3
   bool '  Dont enable graphics-only mode' CONFIG_FB_NOGRAPHICS
   bool '  Virtual Terminal switching'     CONFIG_FB_VT
   bool '  Psion framebuffer hack'         CONFIG_FB_PSION
   bool '  YUV16'                          CONFIG_FB_YUV16
   bool '  Sync double-buffered updates'   CONFIG_FB_SYNC
   bool '  Use page flipping for double-buffered updates' CONFIG_FB_PAGEFLIP
fi
bool 'SDL framebuffer driver'              DRIVER_SDLFB
if [ "$DRIVER_SDLFB" = "y" ]; then
   bool '  Skin support'          CONFIG_SDLSKIN
   bool '  Secondary display channel'      CONFIG_SDLSDC
   choice '  SDL framebuffer low-bpp emulation' \
   	"None                   CONFIG_SDLEMU_NONE \
	 Blit	       		CONFIG_SDLEMU_BLIT \
	 Color			CONFIG_SDLEMU_COLOR" None
fi
bool 'X Window System driver (EXPERIMENTAL)' DRIVER_X11
if [ "$DRIVER_X11" = "y" ]; then
   bool '  Disable slow blending LGOPs' CONFIG_X11_NOSLOWLGOP
   bool '  XFreeType antialiased text (VERY EXPERIMENTAL)'  CONFIG_X11_XFT
fi
bool 'SDL/OpenGL driver (EXPERIMENTAL, see README.opengl)'    DRIVER_SDLGL
bool 'SVGAlib framebuffer driver'          DRIVER_SVGAFB
bool 'Motorola 68EZ328 LCD driver'         DRIVER_EZ328
bool 'Motorola 68EZ328 VGA monitor driver' DRIVER_EZ328VGA
bool 'Ncurses driver'                      DRIVER_NCURSES
bool '40x4 character serial LCD'           DRIVER_SERIAL40X4
bool 'Screen shot driver'                  DRIVER_SCRSHOT
bool 'Null driver'                         DRIVER_NULL
bool 'Null framebuffer driver'             DRIVER_NULLFB
bool 'Zukero EPSON S1D13806 driver'        DRIVER_S1D13806
bool 'EPSON SED133x driver'                DRIVER_SED133X
bool 'MGL2 driver'                         DRIVER_MGL2FB
endmenu

mainmenu_option next_comment
comment 'Input Drivers'
bool 'Touchscreen calibration'		                CONFIG_TOUCHSCREEN
if [ "$CONFIG_TOUCHSCREEN" = "y" ]; then
   bool '  Palmax touchscreen driver'	                DRIVER_PALMAXTS
   bool '  SC3 compatible touchscreen input driver'	DRIVER_SC3TS
   bool '  R3912 (VTech Helio) touchscreen input driver'  DRIVER_R3912TS
   bool '  Sharp Zaurus input driver'                   DRIVER_ZAURUS
fi
bool 'Psion touchscreen (adc7843) driver'            DRIVER_ADC7843
bool 'SDL input driver'                                 DRIVER_SDLINPUT
bool 'X Window System input driver'                     DRIVER_X11INPUT
bool 'SVGAlib input driver'                             DRIVER_SVGAINPUT
bool 'Ncurses input driver'                             DRIVER_NCURSESINPUT
bool 'GPM input driver'			                DRIVER_GPM
bool 'ChipSlice touchscreen input driver'               DRIVER_CHIPSLICETS
bool 'Event broker driver'                              DRIVER_EVENTBROKER
bool 'Agenda VR3 touchscreen input driver'              DRIVER_VR3TS
bool 'Compaq iPAQ H3600 touchscreen input driver'	DRIVER_H3600TS
bool 'Old-Style TuxScreen touchscreen input driver'     DRIVER_TUXTS
if [ "$DRIVER_TUXTS" = "y" ]; then
   bool '  Sound FX support via /dev/wheaties (EXPERIMENTAL)'  DRIVER_TUXTS_WHEATIES
fi
bool 'New-Style TuxScreen touchscreen input driver'     DRIVER_UCB1X00
bool 'TTY keyboard input driver (TuxScreen, fb)'        DRIVER_TTYKB
bool 'Remora keyboard (Chipslice)'                      DRIVER_REMORAKB
bool 'Serial mouse input driver'                        DRIVER_SERIALMOUSE
bool 'MGL2 input driver'                                DRIVER_MGL2INPUT
bool 'Ericsson chatboard driver (see input/README.ericsson_cb)' DRIVER_ERICSSON_CHATBOARD
bool 'PS/2 mouse driver (Also works with USB and Maple)' DRIVER_PS2MOUSE
bool 'Joystick driver'                                  DRIVER_JSDEV
endmenu

mainmenu_option next_comment
comment 'Video Base Libraries'
bool 'Linear framebuffer @ 1bpp'  CONFIG_VBL_LINEAR1
bool 'Linear framebuffer @ 2bpp'  CONFIG_VBL_LINEAR2
bool 'Linear framebuffer @ 4bpp'  CONFIG_VBL_LINEAR4
bool 'Linear framebuffer @ 8bpp'  CONFIG_VBL_LINEAR8
bool 'Linear framebuffer @ 16bpp' CONFIG_VBL_LINEAR16
bool 'Linear framebuffer @ 24bpp' CONFIG_VBL_LINEAR24
bool 'Linear framebuffer @ 32bpp' CONFIG_VBL_LINEAR32
bool 'Fast alpha blending (+ 32K, 16bpp and 32bpp only)' CONFIG_FAST_ALPHA
if [ "$CONFIG_FAST_ALPHA" = "y" ]; then
  choice '16bpp fast alpha color conversion mode' \
	 "5-6-5       CONFIG_FAST_ALPHA_565 \
          5-5-5       CONFIG_FAST_ALPHA_555 \
          4-4-4       CONFIG_FAST_ALPHA_444" 5-6-5
fi  
bool 'Dont write to VRAM with memcpy (16bpp only)' CONFIG_NO_VRAM_MEMCPY
bool 'Planar VGA framebuffer @ 4bpp'  CONFIG_VBL_VGAPLAN4
bool 'Very slow VBL (for debugging)' CONFIG_VBL_SLOWVBL
bool '90 degree video rotation'   CONFIG_ROTATE
bool '180 degree video rotation'  CONFIG_ROTATE180
bool '270 degree video rotation'  CONFIG_ROTATE270
choice 'Base rotation angle' \
   	"0                      CONFIG_ROTATIONBASE_0 \
	 90	       		CONFIG_ROTATIONBASE_90 \
	 180	       		CONFIG_ROTATIONBASE_180 \
	 270			CONFIG_ROTATIONBASE_270" 0
bool 'Base rotation doesnt affect arrow keys'      CONFIG_ROTATIONBASE_NOKEYS
bool 'Base rotation doesnt affect pointing device' CONFIG_ROTATIONBASE_NOPOINTING
endmenu

mainmenu_option next_comment
comment 'Widget Options'
bool 'Terminal widget (VT102 emulator)'       CONFIG_WIDGET_TERMINAL
bool 'Canvas widget (for arbitrary graphics)' CONFIG_WIDGET_CANVAS
bool 'Disable panelbar on app panels'         CONFIG_NOPANELBAR
bool 'Support for solid panel dragging'       CONFIG_DRAGSOLID
int  'Maximum number of zombie gropnodes'     CONFIG_MAX_ZOMBIEGROPS
bool 'Play the "short beep" sound on button press (hack)' CONFIG_BUTTON_BEEP
endmenu

mainmenu_option next_comment
comment 'File Formats'
comment 'Graphics - self contained'
bool 'Internal XBM loader'                               CONFIG_FORMAT_XBM
bool 'PNM: portable anymap'                              CONFIG_FORMAT_PNM
bool 'BMP: windows bitmap'                               CONFIG_FORMAT_BMP
bool 'GIF: graphics interchange format'                  CONFIG_FORMAT_GIF
comment 'Graphics - libraries'
bool 'JPEG: lossy compression (needs libjpeg)'           CONFIG_FORMAT_JPEG
bool 'PNG: portable network graphic (needs libpng)'      CONFIG_FORMAT_PNG
comment 'Text'
bool 'TEXTSAVE: Plain text saving'			 CONFIG_FORMAT_TEXTSAVE
bool 'HTML: hypertext markup'                            CONFIG_FORMAT_HTML
endmenu

mainmenu_option next_comment
comment 'Security'
bool 'Disable remote input devices'           CONFIG_NOREMOTEINPUT
bool 'Disable exclusive resource access'      CONFIG_NOEXCLUSIVE
bool 'Ignore driver messages from clients'    CONFIG_NOCLIENTDRIVERMSG 
int  'Client packet size limit in bytes'      CONFIG_MAXPACKETSZ
bool 'Client quotas (not implemented)'       CONFIG_QUOTA
if [ "$CONFIG_QUOTA" = "y" ]; then
    int '  Number of clients'                 CONFIG_MAXCLIENTS
    int '  Total memory per client in bytes'  CONFIG_MAXCLIENTMEM 
    int '  Handles per client'                CONFIG_MAXCLIENTHANDLES 
fi
endmenu

string 'Profile for pgserver.conf'                CONFIG_PGSERVER_CONF
```
